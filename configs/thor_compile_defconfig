## configs/thor_compile_defconfig
```kconfig
# Host compile/link qualification only.
# A separate platform profile will be added for thor hardware bring-up.
CONFIG_XNU_BUILD_TARGET="build"
CONFIG_XNU_SDKROOT="iphoneos"
CONFIG_XNU_BUILD_WERROR=n
CONFIG_XNU_BOOTSTRAP=n
CONFIG_XNU_BUILD_ARCHIVES=n
CONFIG_XNU_CRYPTO_BOOTSTRAP="source"
CONFIG_XNU_SOURCE_CORECRYPTO14=n
CONFIG_XNU_SOURCE_PTHREAD=n
CONFIG_XNU_SOURCE_MOCKFS=n
CONFIG_XNU_ARM_DT_PLATFORM=n
CONFIG_XNU_ARMVIRT_PLATFORM=n
CONFIG_XNU_ARMCPU=n
CONFIG_XNU_NATIVE_ARCH_TIMER=n
CONFIG_XNU_NATIVE_PAN=n
CONFIG_XNU_DT_PANIC_REGION=n
CONFIG_XNU_NATIVE_UFS=n
CONFIG_XNU_NATIVE_AES=n
CONFIG_XNU_NATIVE_VIRTIO_BLOCK=n
CONFIG_XNU_NATIVE_RAM_BLOCK=n
CONFIG_XNU_NATIVE_VIRTIO_CONSOLE=n
CONFIG_XNU_NATIVE_MOBILE_DISPLAY=n
CONFIG_XNU_NATIVE_LEGACY_DISPLAY=n
CONFIG_XNU_NATIVE_ADRENO=n
CONFIG_XNU_NATIVE_OFFLINE_GPU=n
CONFIG_XNU_NATIVE_AIR_INIT=n
CONFIG_XNU_SHENG_PMGR=n
CONFIG_XNU_TRUST_CACHE_RUNTIME=n
CONFIG_XNU_NATIVE_CS_HASH_CACHE=n
CONFIG_XNU_VERIFIED_ROOT_PROBE=n
CONFIG_XNU_OWNER_ROOT_AUDIT=n
CONFIG_XNU_OWNER_ROOT_TRUST=n
CONFIG_XNU_OWNER_CACHE_MOUNT=n
CONFIG_XNU_OWNER_CACHE_STARTUP=n
CONFIG_XNU_OWNER_BOOT_MANIFEST=n
CONFIG_XNU_OWNER_DATA_MOUNT=n
CONFIG_XNU_OWNER_CRYPTEX_FILES=n
CONFIG_XNU_OWNER_UNION_SYSTEMOS=n
CONFIG_XNU_OWNER_CACHE_CARRIER=n
CONFIG_XNU_OWNER_CACHE_CARRIER_WRONG_UUID=n
CONFIG_XNU_ADRENO_FIRMWARE_PROBE=n
CONFIG_XNU_ADRENO_PM4_PROBE=n
CONFIG_XNU_SMMU4K_PROBE=n
CONFIG_XNU_CONSTANT_UPLOADS_PROBE=n
CONFIG_XNU_ZONE_PGZ_ALIGNMENT_PROBE=n
CONFIG_XNU_BOOT_PROGRESS=n
CONFIG_XNU_EXTRA_LD_ARCHIVES=""
```
